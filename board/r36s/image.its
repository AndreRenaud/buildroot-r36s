## board/r36s/image.its
```
/dts-v1/;

/ {
	description = "Kernel and device tree";
	#address-cells = <1>;

	images {
		kernel-1 {
			description = "Linux kernel";
			data = /incbin/("Image");
			type = "kernel";
			arch = "arm64";
			os = "linux";
			compression = "none";
			load = <0x02000000>;
			entry = <0x02000000>;
			hash-1 {
				algo = "sha256";
			};
		};
		fdt-1 {
			description = "Flattened Device Tree blob";
			data = /incbin/("rk3326-r36s.dtb");
			type = "flat_dt";
			arch = "arm64";
			compression = "none";
			hash-1 {
				algo = "sha256";
			};
		};
	};

	configurations {
		default = "conf-1";
		conf-1 {
			description = "Boot Linux kernel with FDT blob";
			kernel = "kernel-1";
			fdt = "fdt-1";
			hash-1 {
				algo = "sha256";
			};
		};
	};
};
```

## package/libretro-fbneo/Config.in
```kconfig
config BR2_PACKAGE_LIBRETRO_FBNEO
	bool "libretro-fbneo"
	depends on !BR2_STATIC_LIBS
	depends on BR2_INSTALL_LIBSTDCPP
	help
	  FinalBurn Neo, an arcade emulator (Neo Geo, CPS-1/2/3 and
	  many more), as a libretro core. It loads zipped romsets
	  matching its own DAT files. All the drivers are built, so
	  this takes a long time to build and the core is large.

	  Its licence does not allow commercial use.

	  Installs /usr/lib/libretro/fbneo_libretro.so.

	  https://github.com/libretro/FBNeo

comment "libretro-fbneo needs a toolchain w/ C++, dynamic library"
	depends on BR2_STATIC_LIBS || !BR2_INSTALL_LIBSTDCPP
```

## package/libretro-fceumm/Config.in
```kconfig
config BR2_PACKAGE_LIBRETRO_FCEUMM
	bool "libretro-fceumm"
	depends on !BR2_STATIC_LIBS
	help
	  FCEUmm, a NES/Famicom (and Famicom Disk System) emulator, as
	  a libretro core.

	  Installs /usr/lib/libretro/fceumm_libretro.so.

	  https://github.com/libretro/libretro-fceumm

comment "libretro-fceumm needs a toolchain w/ dynamic library"
	depends on BR2_STATIC_LIBS
```

## package/libretro-gambatte/Config.in
```kconfig
config BR2_PACKAGE_LIBRETRO_GAMBATTE
	bool "libretro-gambatte"
	depends on !BR2_STATIC_LIBS
	depends on BR2_INSTALL_LIBSTDCPP
	help
	  Gambatte, an accuracy-focused Game Boy and Game Boy Color
	  emulator, as a libretro core.

	  Installs /usr/lib/libretro/gambatte_libretro.so.

	  https://github.com/libretro/gambatte-libretro

comment "libretro-gambatte needs a toolchain w/ C++, dynamic library"
	depends on BR2_STATIC_LIBS || !BR2_INSTALL_LIBSTDCPP
```

## package/libretro-genesis-plus-gx/Config.in
```kconfig
config BR2_PACKAGE_LIBRETRO_GENESIS_PLUS_GX
	bool "libretro-genesis-plus-gx"
	depends on !BR2_STATIC_LIBS
	help
	  Genesis Plus GX, an accurate Sega Mega Drive/Genesis, Mega
	  CD, Master System, Game Gear and SG-1000 emulator, as a
	  libretro core.

	  Its licence does not allow commercial use.

	  Installs /usr/lib/libretro/genesis_plus_gx_libretro.so.

	  https://github.com/libretro/Genesis-Plus-GX

comment "libretro-genesis-plus-gx needs a toolchain w/ dynamic library"
	depends on BR2_STATIC_LIBS
```

## package/libretro-mame2003-plus/Config.in
```kconfig
config BR2_PACKAGE_LIBRETRO_MAME2003_PLUS
	bool "libretro-mame2003-plus"
	depends on !BR2_STATIC_LIBS
	help
	  MAME 2003-Plus, an arcade emulator based on MAME 0.78 with
	  later drivers backported, as a libretro core. It loads
	  zipped romsets matching its own (0.78-based) DAT file.

	  The MAME licence of that time does not allow commercial
	  use.

	  Installs /usr/lib/libretro/mame2003_plus_libretro.so.

	  https://github.com/libretro/mame2003-plus-libretro

comment "libretro-mame2003-plus needs a toolchain w/ dynamic library"
	depends on BR2_STATIC_LIBS
```

## package/libretro-mgba/Config.in
```kconfig
config BR2_PACKAGE_LIBRETRO_MGBA
	bool "libretro-mgba"
	depends on !BR2_STATIC_LIBS
	help
	  mGBA, a Game Boy Advance emulator (it also runs Game Boy
	  and Game Boy Color games), as a libretro core. It is an
	  interpreter: there is no dynamic recompiler to enable.

	  Installs /usr/lib/libretro/mgba_libretro.so.

	  https://github.com/libretro/mgba

comment "libretro-mgba needs a toolchain w/ dynamic library"
	depends on BR2_STATIC_LIBS
```

## package/libretro-mupen64plus-next/Config.in
```kconfig
config BR2_PACKAGE_LIBRETRO_MUPEN64PLUS_NEXT
	bool "libretro-mupen64plus-next"
	depends on !BR2_STATIC_LIBS
	depends on BR2_INSTALL_LIBSTDCPP
	depends on BR2_TOOLCHAIN_HAS_THREADS
	depends on BR2_PACKAGE_HAS_LIBEGL
	depends on BR2_PACKAGE_HAS_LIBGLES
	help
	  Mupen64Plus-Next, a Nintendo 64 emulator, as a libretro
	  core.

	  Installs /usr/lib/libretro/mupen64plus_next_libretro.so.

	  https://github.com/libretro/mupen64plus-libretro-nx

comment "libretro-mupen64plus-next needs an OpenGL ES and EGL backend, a toolchain w/ C++, threads, dynamic library"
	depends on BR2_STATIC_LIBS || !BR2_INSTALL_LIBSTDCPP || \
		!BR2_TOOLCHAIN_HAS_THREADS || !BR2_PACKAGE_HAS_LIBEGL || \
		!BR2_PACKAGE_HAS_LIBGLES
```

## package/libretro-pcsx-rearmed/Config.in
```kconfig
config BR2_PACKAGE_LIBRETRO_PCSX_REARMED
	bool "libretro-pcsx-rearmed"
	depends on !BR2_STATIC_LIBS
	depends on BR2_TOOLCHAIN_HAS_THREADS
	help
	  PCSX ReARMed, a Sony PlayStation emulator, as a libretro
	  core. It renders in software: no OpenGL is needed. On ARM
	  and AArch64 it is built with the "ari64" dynamic recompiler
	  and, where there is NEON, the NEON GPU plugin.

	  Installs /usr/lib/libretro/pcsx_rearmed_libretro.so.

	  https://github.com/libretro/pcsx_rearmed

comment "libretro-pcsx-rearmed needs a toolchain w/ threads, dynamic library"
	depends on BR2_STATIC_LIBS || !BR2_TOOLCHAIN_HAS_THREADS
```

## package/libretro-picodrive/Config.in
```kconfig
config BR2_PACKAGE_LIBRETRO_PICODRIVE
	bool "libretro-picodrive"
	depends on !BR2_STATIC_LIBS
	help
	  PicoDrive, a fast Sega Mega Drive/Genesis, Mega CD, 32X,
	  Master System and Game Gear emulator, as a libretro core.
	  The SH2 dynamic recompiler (32X) is built on ARM, AArch64,
	  x86, MIPS, RISC-V and PowerPC.

	  Its licence does not allow commercial use.

	  Installs /usr/lib/libretro/picodrive_libretro.so.

	  https://github.com/libretro/picodrive

comment "libretro-picodrive needs a toolchain w/ dynamic library"
	depends on BR2_STATIC_LIBS
```

## package/libretro-snes9x/Config.in
```kconfig
config BR2_PACKAGE_LIBRETRO_SNES9X
	bool "libretro-snes9x"
	depends on !BR2_STATIC_LIBS
	depends on BR2_INSTALL_LIBSTDCPP
	help
	  Snes9x, a Super Nintendo emulator, as a libretro core. This
	  is the current version: the most compatible, but heavy for
	  small CPUs (see libretro-snes9x2005).

	  The Snes9x licence does not allow commercial use.

	  Installs /usr/lib/libretro/snes9x_libretro.so.

	  https://github.com/libretro/snes9x

comment "libretro-snes9x needs a toolchain w/ C++, dynamic library"
	depends on BR2_STATIC_LIBS || !BR2_INSTALL_LIBSTDCPP
```

## package/libretro-snes9x2005/Config.in
```kconfig
config BR2_PACKAGE_LIBRETRO_SNES9X2005
	bool "libretro-snes9x2005"
	depends on !BR2_STATIC_LIBS
	help
	  Snes9x 2005, a libretro core based on Snes9x 1.43: less
	  accurate than libretro-snes9x but much faster, for CPUs
	  that cannot run the current version at full speed.

	  The Snes9x licence does not allow commercial use.

	  Installs /usr/lib/libretro/snes9x2005_libretro.so.

	  https://github.com/libretro/snes9x2005

comment "libretro-snes9x2005 needs a toolchain w/ dynamic library"
	depends on BR2_STATIC_LIBS
```

## package/r36s-gamepad/Config.in
```kconfig
config BR2_PACKAGE_R36S_GAMEPAD
	bool "r36s-gamepad"
	help
	  Presents the R36S buttons (gpio-keys) and analog sticks
	  (adc-joystick) as a single uinput gamepad, "R36S Gamepad",
	  with button codes that SDL maps automatically. Needs
	  CONFIG_INPUT_UINPUT in the kernel.
```

## package/r36s-menu/Config.in
```kconfig
config BR2_PACKAGE_R36S_MENU
	bool "r36s-menu"
	depends on BR2_PACKAGE_HOST_GO_TARGET_ARCH_SUPPORTS
	depends on BR2_aarch64 || BR2_x86_64 # Ebitengine's GBM/KMS backend
	depends on BR2_TOOLCHAIN_HAS_THREADS
	depends on !BR2_STATIC_LIBS # dlopen()
	depends on BR2_PACKAGE_HAS_LIBEGL
	depends on BR2_PACKAGE_HAS_LIBGLES
	depends on BR2_PACKAGE_HAS_LIBGBM
	select BR2_PACKAGE_LIBDRM
	help
	  The R36S's ROM menu: it lists the ROMs on the card in the
	  second SD slot (/roms), with their screenshots, and runs
	  RetroArch with the right libretro core for the chosen one.
	  It also shows the battery level and the card's usage.

	  Written with Ebitengine, which draws with OpenGL ES 3
	  through EGL on a GBM/KMS display, without X11 or Wayland.
	  It loads libEGL, libGLESv2, libgbm and libdrm with dlopen(),
	  so they aren't linked.

	  At run time it needs retroarch and the libretro cores for
	  the systems to be played.

	  https://github.com/AndreRenaud/r36s-menu

comment "r36s-menu needs EGL, OpenGL ES, GBM and a toolchain w/ threads, dynamic library"
	depends on BR2_PACKAGE_HOST_GO_TARGET_ARCH_SUPPORTS
	depends on BR2_aarch64 || BR2_x86_64
	depends on !BR2_PACKAGE_HAS_LIBEGL || !BR2_PACKAGE_HAS_LIBGLES || \
		!BR2_PACKAGE_HAS_LIBGBM || !BR2_TOOLCHAIN_HAS_THREADS || \
		BR2_STATIC_LIBS
```

## package/retroarch/Config.in
```kconfig
config BR2_PACKAGE_RETROARCH
	bool "retroarch"
	depends on BR2_PACKAGE_HAS_LIBEGL
	depends on BR2_PACKAGE_HAS_LIBGLES
	depends on BR2_PACKAGE_HAS_LIBGBM
	depends on BR2_PACKAGE_HAS_UDEV
	depends on BR2_TOOLCHAIN_HAS_THREADS # alsa-lib, libdrm
	depends on !BR2_STATIC_LIBS # dlopen() of the cores
	select BR2_PACKAGE_ALSA_LIB
	select BR2_PACKAGE_LIBDRM
	select BR2_PACKAGE_ZLIB
	help
	  RetroArch, the reference frontend for the libretro API. It
	  loads an emulator ("core") built as a shared library and
	  provides its video, audio and input.

	  This is a minimal console build: KMS/DRM + GBM + EGL video
	  with the OpenGL ES "gl" driver, ALSA audio and udev
	  input/joypads. X11, Wayland, SDL, Vulkan, networking, the
	  online updater and the asset-based menus are all disabled;
	  only the built-in RGUI menu is kept.

	  The cores are separate packages (libretro-*), installed in
	  /usr/lib/libretro. Run one with:

	    retroarch --config /etc/retroarch.cfg \
	        -L /usr/lib/libretro/<core>_libretro.so <rom>

	  No retroarch.cfg is installed: provide one, e.g. from a
	  rootfs overlay.

	  https://www.retroarch.com/

comment "retroarch needs udev /dev management, an EGL/OpenGL ES/GBM provider, a toolchain w/ threads, dynamic library"
	depends on !BR2_PACKAGE_HAS_LIBEGL || !BR2_PACKAGE_HAS_LIBGLES || \
		!BR2_PACKAGE_HAS_LIBGBM || !BR2_PACKAGE_HAS_UDEV || \
		!BR2_TOOLCHAIN_HAS_THREADS || BR2_STATIC_LIBS
```

## package/yquake2/Config.in
```kconfig
config BR2_PACKAGE_YQUAKE2
	bool "yquake2"
	depends on BR2_PACKAGE_HAS_LIBGLES # ref_gles3
	depends on !BR2_STATIC_LIBS # sdl3, dlopen() of renderer and game
	depends on BR2_USE_WCHAR # sdl3
	depends on BR2_TOOLCHAIN_HAS_THREADS # sdl3
	select BR2_PACKAGE_SDL3
	select BR2_PACKAGE_SDL3_OPENGLES
	help
	  Yamagi Quake II, an enhanced client for id Software's
	  Quake II. Only the OpenGL ES 3 renderer (ref_gles3) is
	  built. Enable an SDL3 video driver such as KMS/DRM to run it.

	  The game data is not included. The binaries go in
	  /usr/lib/yquake2 (with a quake2 symlink in /usr/bin), and the
	  game looks for its data in /usr/share/games/quake2/baseq2.

	  https://www.yamagi.org/quake2/

if BR2_PACKAGE_YQUAKE2

config BR2_PACKAGE_YQUAKE2_DEMO_DATA
	bool "Quake II demo data"
	help
	  Download the Quake II demo (q2-314-demo-x86.exe) and install
	  its game data (pak0.pak and the player skins) in
	  /usr/share/games/quake2/baseq2. It contains the first few
	  levels of the game.

	  The demo data is not free software. id Software's demo licence
	  allows only non-commercial, recreational use; forbids public
	  display, selling and commercial use; and allows redistribution
	  only free of charge, by electronic means, with the licence
	  attached. The licence is installed as
	  /usr/share/games/quake2/demo-license.txt.

endif

comment "yquake2 needs OpenGL ES and a toolchain w/ dynamic library, wchar, threads"
	depends on !BR2_PACKAGE_HAS_LIBGLES || BR2_STATIC_LIBS || \
		!BR2_USE_WCHAR || !BR2_TOOLCHAIN_HAS_THREADS
```
